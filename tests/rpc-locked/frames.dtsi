/*
 * Generated by tests/rpc/rpc-vectors.mjs with the TypeScript Studio client's own
 * encoder and framing. Do not edit; change the script and run `gen` again.
 *
 * request 0: {"macroGetInfo":true}
 * request 1: {"macroGetSlot":{"slot":0}}
 * request 2: {"macroRead":{"slot":0,"offset":0}}
 * request 3: {"macroWrite":{"slot":0,"offset":0,"steps":[458779]}}
 * request 4: {"macroCommit":{"slot":0,"stepCount":1,"name":[]}}
 * request 5: {"macroClear":{"slot":0}}
 * request 6: {"macroGetSlot":{"slot":0}}
 * request 7: {"macroRead":{"slot":0,"offset":0}}
 */

&emacro_test {
    rpc-frames = [
        ab 1a 03 a0 06 01 ad
        ab 08 01 1a 03 aa 06 00 ad
        ab 08 02 1a 03 b2 06 00 ad
        ab 08 03 1a 08 ba 06 05 1a 03 9b 80 1c ad
        ab 08 04 1a 07 c2 06 04 10 01 1a 00 ad
        ab 08 05 1a 03 ca 06 00 ad
        ab 08 06 1a 03 aa 06 00 ad
        ab 08 07 1a 03 b2 06 00 ad
    ];
};

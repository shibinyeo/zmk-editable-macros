/*
 * Generated by tests/rpc/rpc-vectors.mjs with the TypeScript Studio client's own
 * encoder and framing. Do not edit; change the script and run `gen` again.
 *
 * request 0: {"macroClear":{"slot":2}}
 * request 1: {"macroGetSlot":{"slot":2}}
 * request 2: {"macroWrite":{"slot":99,"offset":0,"steps":[458756]}}
 * request 3: {"macroWrite":{"slot":0,"offset":5,"steps":[458756]}}
 * request 4: {"macroWrite":{"slot":0,"offset":0,"steps":[458756,458757]}}
 * request 5: {"macroWrite":{"slot":0,"offset":2,"steps":[65584]}}
 * request 6: {"macroCommit":{"slot":0,"stepCount":5,"name":[]}}
 * request 7: {"macroCommit":{"slot":0,"stepCount":2,"name":"2 bytes"}}
 * request 8: {"macroCommit":{"slot":0,"stepCount":2,"name":"1 bytes"}}
 * request 9: {"macroCommit":{"slot":99,"stepCount":0,"name":[]}}
 * request 10: {"macroClear":{"slot":99}}
 * request 11: {"macroGetSlot":{"slot":99}}
 * request 12: {"macroRead":{"slot":99,"offset":0}}
 * request 13: {"macroGetSlot":{"slot":0}}
 * request 14: {"macroCommit":{"slot":0,"stepCount":2,"name":"2 bytes"}}
 * request 15: {"macroGetSlot":{"slot":0}}
 * request 16: core request 150 (unknown) = true
 * request 17: {"macroWrite":{"slot":0,"offset":0,"steps":"17 steps"}}
 * request 18: {"macroGetInfo":true}
 */

&emacro_test {
    rpc-frames = [
        ab 1a 05 ca 06 02 08 02 ad
        ab 08 01 1a 05 aa 06 02 08 02 ad
        ab 08 02 1a 0a ba 06 07 08 63 1a 03 84 80 1c ad
        ab 08 03 1a 0a ba 06 07 10 05 1a 03 84 80 1c ad
        ab 08 04 1a 0b ba 06 08 1a 06 84 80 1c 85 80 1c ad
        ab 08 05 1a 0a ba 06 07 10 02 1a 03 b0 80 04 ad
        ab 08 06 1a 07 c2 06 04 10 05 1a 00 ad
        ab 08 07 1a 0a c2 06 07 10 02 1a 03 41 80 02 ad
        ab 08 08 1a 08 c2 06 05 10 02 1a 01 0a ad
        ab 08 09 1a 07 c2 06 04 08 63 1a 00 ad
        ab 08 0a 1a 05 ca 06 02 08 63 ad
        ab 08 0b 1a 05 aa 06 02 08 63 ad
        ab 08 0c 1a 05 b2 06 02 08 63 ad
        ab 08 0d 1a 03 aa 06 00 ad
        ab 08 0e 1a 09 c2 06 06 10 02 1a 02 6f 6b ad
        ab 08 0f 1a 03 aa 06 00 ad
        ab 08 10 1a 03 b0 09 01 ad
        ab 08 11 1a 38 ba 06 35 1a 33 84 80 1c 84 80 1c 84 80 1c 84 80 1c 84 80 1c 84 80 1c 84 80 1c 84 80 1c 84 80 1c 84 80 1c 84 80 1c 84 80 1c 84 80 1c 84 80 1c 84 80 1c 84 80 1c 84 80 1c ad
        ab 08 12 1a 03 a0 06 01 ad
    ];
};

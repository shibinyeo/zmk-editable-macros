/*
 * Generated by tests/rpc/rpc-vectors.mjs with the TypeScript Studio client's own
 * encoder and framing. Do not edit; change the script and run `gen` again.
 *
 * request 0: {"macroGetInfo":true}
 * request 1: {"macroGetSlot":{"slot":1}}
 * request 2: {"macroWrite":{"slot":1,"offset":0,"steps":"16 steps"}}
 * request 3: {"macroWrite":{"slot":1,"offset":16,"steps":[458775,458795,458796,458792]}}
 * request 4: {"macroCommit":{"slot":1,"stepCount":20,"name":"9 bytes"}}
 * request 5: {"macroGetSlot":{"slot":1}}
 * request 6: {"macroRead":{"slot":1,"offset":0}}
 * request 7: {"macroRead":{"slot":1,"offset":16}}
 * request 8: {"macroRead":{"slot":1,"offset":20}}
 * request 9: {"macroGetInfo":true}
 */

&emacro_test {
    rpc-frames = [
        ab 1a 03 a0 06 01 ad
        ab 08 01 1a 05 aa 06 02 08 01 ad
        ab 08 02 1a 3b ba 06 38 08 01 1a 34 8b 80 9c 10 88 80 1c 8f 80 1c 8f 80 1c 92 80 1c b6 80 1c ac ac 80 1c ac ab 80 1c ac ad 80 1c ac ad 80 1c ac ac 80 1c 84 80 9c 80 08 9d 80 9c 78 9e 80 1c e9 81 30 c5 80 1c ad
        ab 08 03 1a 15 ba 06 12 08 01 10 10 1a 0c 97 80 1c ac ab 80 1c ac ac 80 1c a8 80 1c ad
        ab 08 04 1a 12 c2 06 0f 08 01 10 14 1a 09 53 69 67 6e 61 74 75 72 65 ad
        ab 08 05 1a 05 aa 06 02 08 01 ad
        ab 08 06 1a 05 b2 06 02 08 01 ad
        ab 08 07 1a 07 b2 06 04 08 01 10 10 ad
        ab 08 08 1a 07 b2 06 04 08 01 10 14 ad
        ab 08 09 1a 03 a0 06 01 ad
    ];
};

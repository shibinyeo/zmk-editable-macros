/*
 * Generated by tests/rpc/rpc-vectors.mjs with the TypeScript Studio client's own
 * encoder and framing. Do not edit; change the script and run `gen` again.
 *
 * request 0: {"macroWrite":{"slot":0,"offset":0,"steps":[2147942404]}}
 * request 1: {"macroWrite":{"slot":0,"offset":1,"steps":[458757,458758]}}
 * request 2: {"macroWrite":{"slot":0,"offset":3,"steps":[34013191,458760,2147942409]}}
 * request 3: {"macroWrite":{"slot":0,"offset":6,"steps":[34013194,458763,458764,34013197]}}
 * request 4: {"macroWrite":{"slot":0,"offset":10,"steps":[2147942414,458767,34013200,458769,458770]}}
 * request 5: {"macroWrite":{"slot":0,"offset":15,"steps":[2147942419,458772,458773,34013206,458775,2147942424]}}
 * request 6: {"macroWrite":{"slot":0,"offset":21,"steps":"7 steps"}}
 * request 7: {"macroWrite":{"slot":0,"offset":28,"steps":"8 steps"}}
 * request 8: {"macroWrite":{"slot":0,"offset":36,"steps":"9 steps"}}
 * request 9: {"macroWrite":{"slot":0,"offset":45,"steps":"10 steps"}}
 * request 10: {"macroWrite":{"slot":0,"offset":55,"steps":"11 steps"}}
 * request 11: {"macroWrite":{"slot":0,"offset":66,"steps":"12 steps"}}
 * request 12: {"macroWrite":{"slot":0,"offset":78,"steps":"13 steps"}}
 * request 13: {"macroWrite":{"slot":0,"offset":91,"steps":"14 steps"}}
 * request 14: {"macroWrite":{"slot":0,"offset":105,"steps":"15 steps"}}
 * request 15: {"macroWrite":{"slot":0,"offset":120,"steps":"16 steps"}}
 * request 16: {"macroWrite":{"slot":0,"offset":136,"steps":[458792]}}
 * request 17: {"macroWrite":{"slot":0,"offset":137,"steps":[458793,34013226]}}
 * request 18: {"macroWrite":{"slot":0,"offset":139,"steps":[458795,2147942444,34013229]}}
 * request 19: {"macroWrite":{"slot":0,"offset":142,"steps":[458798,458799,34013232,2147942449]}}
 * request 20: {"macroWrite":{"slot":0,"offset":146,"steps":[458802,34013235,458804,458805,2147942404]}}
 * request 21: {"macroWrite":{"slot":0,"offset":151,"steps":[458757,458758,34013191,458760,2147942409,34013194]}}
 * request 22: {"macroWrite":{"slot":0,"offset":157,"steps":"7 steps"}}
 * request 23: {"macroWrite":{"slot":0,"offset":164,"steps":"8 steps"}}
 * request 24: {"macroWrite":{"slot":0,"offset":172,"steps":"9 steps"}}
 * request 25: {"macroWrite":{"slot":0,"offset":181,"steps":"10 steps"}}
 * request 26: {"macroWrite":{"slot":0,"offset":191,"steps":"11 steps"}}
 * request 27: {"macroWrite":{"slot":0,"offset":202,"steps":"12 steps"}}
 * request 28: {"macroWrite":{"slot":0,"offset":214,"steps":"13 steps"}}
 * request 29: {"macroWrite":{"slot":0,"offset":227,"steps":"14 steps"}}
 * request 30: {"macroCommit":{"slot":0,"stepCount":241,"name":"4 bytes"}}
 * request 31: {"macroGetSlot":{"slot":0}}
 * request 32: {"macroRead":{"slot":0,"offset":0}}
 * request 33: {"macroRead":{"slot":0,"offset":32}}
 * request 34: {"macroRead":{"slot":0,"offset":64}}
 * request 35: {"macroRead":{"slot":0,"offset":96}}
 * request 36: {"macroRead":{"slot":0,"offset":128}}
 * request 37: {"macroRead":{"slot":0,"offset":160}}
 * request 38: {"macroRead":{"slot":0,"offset":192}}
 * request 39: {"macroRead":{"slot":0,"offset":224}}
 * request 40: {"macroGetInfo":true}
 */

&emacro_test {
    rpc-frames = [
        ab 1a 0a ba 06 07 1a 05 84 80 9c 80 08 ad
        ab 08 01 1a 0d ba 06 0a 10 01 1a 06 85 80 1c 86 80 1c ad
        ab 08 02 1a 13 ba 06 10 10 03 1a 0c 87 80 9c 10 88 80 1c 89 80 9c 80 08 ad
        ab 08 03 1a 15 ba 06 12 10 06 1a 0e 8a 80 9c 10 8b 80 1c 8c 80 1c 8d 80 9c 10 ad
        ab 08 04 1a 19 ba 06 16 10 0a 1a 12 8e 80 9c 80 08 8f 80 1c 90 80 9c 10 91 80 1c 92 80 1c ad
        ab 08 05 1a 1e ba 06 1b 10 0f 1a 17 93 80 9c 80 08 94 80 1c 95 80 1c 96 80 9c 10 97 80 1c 98 80 9c 80 08 ad
        ab 08 06 1a 21 ba 06 1e 10 15 1a 1a 99 80 9c 10 9a 80 1c 9b 80 1c 9c 80 9c 10 9d 80 9c 80 08 9e 80 1c 9f 80 9c 10 ad
        ab 08 07 1a 24 ba 06 21 10 1c 1a 1d a0 80 1c a1 80 1c a2 80 9c 80 08 a3 80 1c a4 80 1c a5 80 9c 10 a6 80 1c a7 80 9c 80 08 ad
        ab 08 08 1a 27 ba 06 24 10 24 1a 20 a8 80 9c 10 a9 80 1c aa 80 1c ac ab 80 9c 10 ac ac 80 9c 80 08 ac ad 80 1c ae 80 9c 10 af 80 1c b0 80 1c ad
        ab 08 09 1a 2c ba 06 29 10 2d 1a 25 b1 80 9c 80 08 b2 80 1c b3 80 1c b4 80 9c 10 b5 80 1c 84 80 9c 80 08 85 80 9c 10 86 80 1c 87 80 1c 88 80 9c 10 ad
        ab 08 0a 1a 30 ba 06 2d 10 37 1a 29 89 80 9c 80 08 8a 80 1c 8b 80 9c 10 8c 80 1c 8d 80 1c 8e 80 9c 80 08 8f 80 1c 90 80 1c 91 80 9c 10 92 80 1c 93 80 9c 80 08 ad
        ab 08 0b 1a 32 ba 06 2f 10 42 1a 2b 94 80 9c 10 95 80 1c 96 80 1c 97 80 9c 10 98 80 9c 80 08 99 80 1c 9a 80 9c 10 9b 80 1c 9c 80 1c 9d 80 9c 80 08 9e 80 1c 9f 80 1c ad
        ab 08 0c 1a 38 ba 06 35 10 4e 1a 31 a0 80 9c 10 a1 80 1c a2 80 9c 80 08 a3 80 9c 10 a4 80 1c a5 80 1c a6 80 9c 10 a7 80 9c 80 08 a8 80 1c a9 80 9c 10 aa 80 1c ac ab 80 1c ac ac 80 9c 80 08 ad
        ab 08 0d 1a 39 ba 06 36 10 5b 1a 32 ac ad 80 1c ae 80 1c af 80 9c 10 b0 80 1c b1 80 9c 80 08 b2 80 9c 10 b3 80 1c b4 80 1c b5 80 9c 10 84 80 9c 80 08 85 80 1c 86 80 9c 10 87 80 1c 88 80 1c ad
        ab 08 0e 1a 3e ba 06 3b 10 69 1a 37 89 80 9c 80 08 8a 80 1c 8b 80 1c 8c 80 9c 10 8d 80 1c 8e 80 9c 80 08 8f 80 9c 10 90 80 1c 91 80 1c 92 80 9c 10 93 80 9c 80 08 94 80 1c 95 80 9c 10 96 80 1c 97 80 1c ad
        ab 08 0f 1a 43 ba 06 40 10 78 1a 3c 98 80 9c 80 08 99 80 1c 9a 80 1c 9b 80 9c 10 9c 80 1c 9d 80 9c 80 08 9e 80 9c 10 9f 80 1c a0 80 1c a1 80 9c 10 a2 80 9c 80 08 a3 80 1c a4 80 9c 10 a5 80 1c a6 80 1c a7 80 9c 80 08 ad
        ab 08 10 1a 0b ba 06 08 10 88 01 1a 03 a8 80 1c ad
        ab 08 11 1a 0f ba 06 0c 10 89 01 1a 07 a9 80 1c aa 80 9c 10 ad
        ab 08 12 1a 14 ba 06 11 10 8b 01 1a 0c ac ab 80 1c ac ac 80 9c 80 08 ac ad 80 9c 10 ad
        ab 08 13 1a 17 ba 06 14 10 8e 01 1a 0f ae 80 1c af 80 1c b0 80 9c 10 b1 80 9c 80 08 ad
        ab 08 14 1a 1a ba 06 17 10 92 01 1a 12 b2 80 1c b3 80 9c 10 b4 80 1c b5 80 1c 84 80 9c 80 08 ad
        ab 08 15 1a 1e ba 06 1b 10 97 01 1a 16 85 80 1c 86 80 1c 87 80 9c 10 88 80 1c 89 80 9c 80 08 8a 80 9c 10 ad
        ab 08 16 1a 21 ba 06 1e 10 9d 01 1a 19 8b 80 1c 8c 80 1c 8d 80 9c 10 8e 80 9c 80 08 8f 80 1c 90 80 9c 10 91 80 1c ad
        ab 08 17 1a 26 ba 06 23 10 a4 01 1a 1e 92 80 1c 93 80 9c 80 08 94 80 1c 95 80 1c 96 80 9c 10 97 80 1c 98 80 9c 80 08 99 80 9c 10 ad
        ab 08 18 1a 29 ba 06 26 10 ac ac 01 1a 21 9a 80 1c 9b 80 1c 9c 80 9c 10 9d 80 9c 80 08 9e 80 1c 9f 80 9c 10 a0 80 1c a1 80 1c a2 80 9c 80 08 ad
        ab 08 19 1a 2d ba 06 2a 10 b5 01 1a 25 a3 80 1c a4 80 1c a5 80 9c 10 a6 80 1c a7 80 9c 80 08 a8 80 9c 10 a9 80 1c aa 80 1c ac ab 80 9c 10 ac ac 80 9c 80 08 ad
        ab 08 1a 1a 30 ba 06 2d 10 bf 01 1a 28 ac ad 80 1c ae 80 9c 10 af 80 1c b0 80 1c b1 80 9c 80 08 b2 80 1c b3 80 1c b4 80 9c 10 b5 80 1c 84 80 9c 80 08 85 80 9c 10 ad
        ab 08 1b 1a 33 ba 06 30 10 ca 01 1a 2b 86 80 1c 87 80 1c 88 80 9c 10 89 80 9c 80 08 8a 80 1c 8b 80 9c 10 8c 80 1c 8d 80 1c 8e 80 9c 80 08 8f 80 1c 90 80 1c 91 80 9c 10 ad
        ab 08 1c 1a 38 ba 06 35 10 d6 01 1a 30 92 80 1c 93 80 9c 80 08 94 80 9c 10 95 80 1c 96 80 1c 97 80 9c 10 98 80 9c 80 08 99 80 1c 9a 80 9c 10 9b 80 1c 9c 80 1c 9d 80 9c 80 08 9e 80 1c ad
        ab 08 1d 1a 3c ba 06 39 10 e3 01 1a 34 9f 80 1c a0 80 9c 10 a1 80 1c a2 80 9c 80 08 a3 80 9c 10 a4 80 1c a5 80 1c a6 80 9c 10 a7 80 9c 80 08 a8 80 1c a9 80 9c 10 aa 80 1c ac ab 80 1c ac ac 80 9c 80 08 ad
        ab 08 1e 1a 0c c2 06 09 10 f1 01 1a 04 77 72 61 70 ad
        ab 08 1f 1a 03 aa 06 00 ad
        ab 08 20 1a 03 b2 06 00 ad
        ab 08 21 1a 05 b2 06 02 10 20 ad
        ab 08 22 1a 05 b2 06 02 10 40 ad
        ab 08 23 1a 05 b2 06 02 10 60 ad
        ab 08 24 1a 06 b2 06 03 10 80 01 ad
        ab 08 25 1a 06 b2 06 03 10 a0 01 ad
        ab 08 26 1a 06 b2 06 03 10 c0 01 ad
        ab 08 27 1a 06 b2 06 03 10 e0 01 ad
        ab 08 28 1a 03 a0 06 01 ad
    ];
};

## dts/bindings/behaviors/zmk,behavior-editable-macro-test.yaml
```yaml
# Copyright (c) 2026 The zmk-editable-macros contributors
# SPDX-License-Identifier: MIT

description: |
  Test-only behavior that performs a store operation when its key is pressed, so
  automated tests can edit macros in the middle of a key sequence.
  The parameter selects the action; see src/behavior_editable_macro_test.c.

compatible: "zmk,behavior-editable-macro-test"

include: one_param.yaml
```

## dts/bindings/behaviors/zmk,behavior-editable-macro.yaml
```yaml
# Copyright (c) 2026 The zmk-editable-macros contributors
# SPDX-License-Identifier: MIT

description: |
  Macro whose key sequence is stored on the keyboard and edited at runtime.
  The single binding parameter is the slot number, e.g. `&emacro 0`.

compatible: "zmk,behavior-editable-macro"

include: one_param.yaml

properties:
  tap-ms:
    type: int
    description: |
      How long each key is held, in milliseconds.
      Defaults to CONFIG_ZMK_MACRO_DEFAULT_TAP_MS, the same default stock macros use.
  wait-ms:
    type: int
    description: |
      Pause after each key is released, in milliseconds.
      Defaults to CONFIG_ZMK_MACRO_DEFAULT_WAIT_MS, the same default stock macros use.
```

## dts/bindings/zmk,editable-macro-test.yaml
```yaml
# Copyright (c) 2026 The zmk-editable-macros contributors
# SPDX-License-Identifier: MIT

description: |
  Test support for editable macros: fills slots when the firmware starts.
  Used by the automated tests and for first hardware bring-up, before any
  editor exists. Not meant for a keyboard in normal use, because the seeded
  slots are rewritten on every boot.

compatible: "zmk,editable-macro-test"

properties:
  reload:
    type: boolean
    description: |
      After seeding, forget the RAM copy of every slot and load them again from
      settings, to prove that what was stored is what comes back.

  rpc-frames:
    type: uint8-array
    description: |
      Studio request frames, concatenated, each exactly as it would arrive on the wire
      (0xAB ... 0xAD). After seeding, they are fed to the RPC thread one at a time
      through a stand-in transport, and every reply is logged in hex.
  rpc-frame-interval-ms:
    type: int
    default: 20
    description: Time between one request frame and the next.

child-binding:
  description: One slot to fill.
  properties:
    slot:
      type: int
      required: true
    macro-name:
      type: string
    steps:
      type: array
      description: |
        Key taps, written like `&kp` parameters, e.g. <A LS(B) N1>. Committed
        through the same stage-then-commit path an editor uses.
    raw:
      type: uint8-array
      description: |
        Bytes stored verbatim as the slot's settings value, bypassing every check.
        For testing how damaged records are handled.
    raw-key:
      type: string
      description: Full settings key to store `raw` under, instead of the slot's own key.
```
